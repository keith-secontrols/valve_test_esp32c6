## sdkconfig.defaults
```kconfig
# Target
CONFIG_IDF_TARGET="esp32c6"

# Flash size
CONFIG_ESPTOOLPY_FLASHSIZE_4MB=y
CONFIG_ESPTOOLPY_FLASHSIZE="4MB"

# Console on UART0 (TX=GPIO16, RX=GPIO17) instead of USB-Serial-JTAG
CONFIG_ESP_CONSOLE_UART_DEFAULT=y
CONFIG_ESP_CONSOLE_UART_NUM=0
CONFIG_ESP_CONSOLE_UART_TX_GPIO=16
CONFIG_ESP_CONSOLE_UART_RX_GPIO=17
CONFIG_ESP_CONSOLE_UART_BAUDRATE=115200

# Disable radio subsystems — no WiFi/BT/Thread in this project
# Run 'idf.py menuconfig' under Component config to confirm/adjust
CONFIG_BT_ENABLED=n
CONFIG_IEEE802154_ENABLED=n
```
